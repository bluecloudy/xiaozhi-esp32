## sdkconfig.defaults
```kconfig
CONFIG_COMPILER_OPTIMIZATION_SIZE=y
CONFIG_COMPILER_CXX_EXCEPTIONS=y
CONFIG_COMPILER_CXX_EXCEPTIONS_EMG_POOL_SIZE=1024
CONFIG_COMPILER_CXX_RTTI=y

CONFIG_BOOTLOADER_COMPILER_OPTIMIZATION_PERF=y
CONFIG_BOOTLOADER_LOG_LEVEL_NONE=y
CONFIG_BOOTLOADER_SKIP_VALIDATE_ALWAYS=y
CONFIG_BOOTLOADER_APP_ROLLBACK_ENABLE=y

CONFIG_HTTPD_MAX_REQ_HDR_LEN=2048
CONFIG_HTTPD_MAX_URI_LEN=2048

CONFIG_PARTITION_TABLE_CUSTOM=y
CONFIG_PARTITION_TABLE_CUSTOM_FILENAME="partitions/v2/16m.csv"
CONFIG_PARTITION_TABLE_OFFSET=0x8000

CONFIG_ESP_TASK_WDT_TIMEOUT_S=10
CONFIG_FREERTOS_GENERATE_RUN_TIME_STATS=n
CONFIG_FREERTOS_USE_STATS_FORMATTING_FUNCTIONS=n

CONFIG_ESP_MAIN_TASK_STACK_SIZE=8192
CONFIG_MBEDTLS_DYNAMIC_BUFFER=y
CONFIG_MBEDTLS_SSL_KEEP_PEER_CERTIFICATE=n
CONFIG_ESP_WIFI_IRAM_OPT=n
CONFIG_ESP_WIFI_RX_IRAM_OPT=n
CONFIG_ESP_WIFI_DYNAMIC_RX_MGMT_BUFFER=y

# These entries are copied from ESP-HI (ESP32C3) to reduce memory usage
CONFIG_ESP_WIFI_STATIC_RX_BUFFER_NUM=6
CONFIG_ESP_WIFI_DYNAMIC_RX_BUFFER_NUM=8
CONFIG_NEWLIB_NANO_FORMAT=y
CONFIG_ESP_WIFI_ENTERPRISE_SUPPORT=n

CONFIG_CODEC_I2C_BACKWARD_COMPATIBLE=n

# Normalization features
CONFIG_ENABLE_TEXT_NORMALIZATION=y
CONFIG_ENABLE_WAKEWORD_ECHO_FILTER=y
CONFIG_ENABLE_KID_ANSWER_VALIDATION=y
CONFIG_STT_NOISE_REPEATED_MIN_TOKENS=4
CONFIG_STT_NOISE_REPEATED_DOMINANCE_PERCENT=75
CONFIG_STT_NOISE_REPEATED_MAX_UNIQUE_TOKENS=2
CONFIG_STT_NOISE_REPEATED_MAX_TOKEN_LENGTH=3
CONFIG_STT_LONG_FRAGMENT_MULTIPLIER=4
CONFIG_STT_LONG_FRAGMENT_MARGIN_WORDS=8
CONFIG_STT_LEARNING_SHORT_PHRASE_DEFAULT_MAX_WORDS=3
CONFIG_STT_KID_ANSWER_MAX_NORMALIZED_CHARS=12

# Voice session policy thresholds
CONFIG_VOICE_SESSION_LISTENING_TIMEOUT_TICKS=5
CONFIG_TTS_GRACE_PERIOD_MS=400

# Keep optional phonetic normalization off by default for behavior stability.
# CONFIG_ENABLE_PHONETIC_NORMALIZATION is not set

# Fix ML307 FIFO Overflow
CONFIG_UART_ISR_IN_IRAM=y

# Fix ESP_SSL error
CONFIG_MBEDTLS_SSL_RENEGOTIATION=n

# LVGL 9.2.2

CONFIG_LV_OS_NONE=y
CONFIG_LV_USE_CLIB_MALLOC=y
CONFIG_LV_USE_CLIB_STRING=y
CONFIG_LV_USE_CLIB_SPRINTF=y
CONFIG_LV_USE_IMGFONT=y
CONFIG_LV_USE_ASSERT_STYLE=y

# Use compressed font
CONFIG_LV_FONT_FMT_TXT_LARGE=y
CONFIG_LV_USE_FONT_COMPRESSED=n
CONFIG_LV_USE_FONT_PLACEHOLDER=n
CONFIG_LV_USE_LODEPNG=y

# Disable extra widgets to save flash size
CONFIG_LV_USE_ANIMIMG=n
CONFIG_LV_USE_CALENDAR=n
CONFIG_LV_USE_CALENDAR_HEADER_ARROW=n
CONFIG_LV_USE_CALENDAR_HEADER_DROPDOWN=n
CONFIG_LV_USE_CHART=n
CONFIG_LV_USE_KEYBOARD=n
CONFIG_LV_USE_LED=n
CONFIG_LV_USE_LIST=n
CONFIG_LV_USE_MENU=n
CONFIG_LV_USE_MSGBOX=n
CONFIG_LV_USE_SPAN=n
CONFIG_LV_USE_SPINBOX=n
CONFIG_LV_USE_SPINNER=n
CONFIG_LV_USE_TABVIEW=n
CONFIG_LV_USE_TILEVIEW=n
CONFIG_LV_USE_WIN=n

CONFIG_LV_BUILD_EXAMPLES=n
CONFIG_LV_BUILD_DEMOS=n
```

## sdkconfig.defaults.esp32s3-led-096-hi-lily-vi
```kconfig
# Minimal delta defaults for ESP32-S3 + 0.96 OLED + Hi Lily + Vietnamese.
# Intended to be used together with sdkconfig.defaults.esp32s3.

# Board (hardware/platform)
CONFIG_BOARD_TYPE_XINGZHI_CUBE_0_96OLED_WIFI=y

# Language: Vietnamese UI/system strings
CONFIG_LANGUAGE_VI_VN=y

# Wake model selection (engine/model only)
CONFIG_SR_WN_WN9_HILILI_TTS=y

# Keep wake model deterministic for this profile.
# CONFIG_USE_AFE_WAKE_WORD is not set
# CONFIG_SR_WN_WN9_NIHAOXIAOZHI_TTS is not set

# LVGL Graphics
CONFIG_LV_USE_SNAPSHOT=y
CONFIG_LV_USE_IMGFONT=y
CONFIG_LV_FONT_FMT_TXT_LARGE=y

# C++ exceptions and RTTI for this profile.
CONFIG_COMPILER_CXX_EXCEPTIONS=y
CONFIG_COMPILER_CXX_EXCEPTIONS_EMG_POOL_SIZE=1024
CONFIG_COMPILER_CXX_RTTI=y

# Partition table
CONFIG_PARTITION_TABLE_CUSTOM=y
CONFIG_PARTITION_TABLE_CUSTOM_FILENAME="partitions/v2/16m.csv"
CONFIG_PARTITION_TABLE_OFFSET=0x8000
```
